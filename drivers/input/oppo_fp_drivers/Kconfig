## drivers/input/oppo_fp_drivers/Kconfig
```kconfig
menuconfig OPPO_FINGERPRINT
	bool "OPPO fingerprint"
	depends on SPI_MASTER
	help
	  Say Y here to enable OPPO fingerprint support

if OPPO_FINGERPRINT

config OPPO_FINGERPRINT_QCOM
       default n
       tristate "Fingerprint base on QCOM"

config OPPO_FINGERPRINT_MTK
       default n
       tristate "Fingerprint base on MTK"
config OPPO_FINGERPRINT_CHIP
       default 1245
       tristate "Fingerprint chip"

endif #OPPO_FINGERPRINT
```

## drivers/power/Kconfig
```kconfig
source "drivers/power/avs/Kconfig"
source "drivers/power/reset/Kconfig"
source "drivers/power/supply/Kconfig"
source "drivers/power/qcom/Kconfig"

#ifdef VENDOR_EDIT /* Jianchao.Shi@BSP.CHG.Basic, 2018/01/12, sjc Add for charging */
config OPPO_SDM670P_CHARGER
	tristate "OPPO SDM670 charger driver"
	depends on MFD_SPMI_PMIC
	help
	  Enables support for the oppo charging framework

config OPPO_SHORT_C_BATT_CHECK
	tristate "OPPO_SHORT_C_BATT CHECK SUPPORT"
	default n
	depends on MFD_SPMI_PMIC
	help
	  Say Y to include support

config OPPO_SHORT_HW_CHECK
	tristate "OPPO_SHORT_HW CHECK SUPPORT"
	default n
	depends on MFD_SPMI_PMIC
	help
	  Say Y to include support

config OPPO_SHORT_IC_CHECK
	tristate "OPPO_SHORT_IC CHECK SUPPORT"
	default n
	depends on MFD_SPMI_PMIC
	help
	  Say Y to include support

config OPPO_RTC_DET_SUPPORT
	tristate "OPPO RTC DET SUPPORT"
	default n
	depends on MFD_SPMI_PMIC
	help
	  Say Y to include support

config OPPO_CHECK_CHARGERID_VOLT
	tristate "OPPO CHECK CHARGERID VOLT"
	default n
	depends on MFD_SPMI_PMIC
	help
	  Say Y to include support

config OPPO_SHIP_MODE_SUPPORT
	tristate "OPPO_SHIP_MODE_SUPPORT"
	default n
	depends on MFD_SPMI_PMIC
	help
	  Say Y to include support

config OPPO_SHORT_USERSPACE
	bool "OPPO batt userspace"
	help
	  Say Y to include support
source "drivers/power/oppo/Kconfig"
#endif
```

## drivers/power/oppo/Kconfig
```kconfig
menuconfig OPPO_CHARGER
	bool "OPPO charging system"
	depends on I2C
	select REGMAP_I2C
	help
	  Say Y here to enable OPPO charging system support

if OPPO_CHARGER
config OPPO_STANDARD_BATTERY_CHECK_ADC
	bool "OPPO Official Standard Battery check by ADC"
	help
	  Say Y here to support Official Standard Battery check by ADC
endif #OPPO_CHARGER
```

## drivers/soc/oppo/Kconfig
```kconfig
# ifdef VENDOR_EDIT 
# yixue.ge add for config oppo software common soft
config OPPO_ARCH_FILE
	bool "for build directory oppo"
	---help---
	say Y to buid in

config OPPO_COMMON_SOFT
      bool "config oppo common software"
	  select OPPO_ARCH_FILE
	  help
		define this config to get project verion from sharemem.
		Maybe this value is from CDT or dynamic identify by hardware
		id.

config OPPO_DEVICE_IFNO
      bool "config oppo devinfo"
	  select OPPO_ARCH_FILE
	  help
		define this config to compile devinfo.c for device register
		.
source "drivers/soc/oppo/oppo_project/Kconfig"

source "drivers/soc/oppo/oppo_devinfo/Kconfig"
```
