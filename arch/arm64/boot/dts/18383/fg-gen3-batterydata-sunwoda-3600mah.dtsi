
qcom,oppo_sunwoda_3600mah {
	qcom, = <24>;
	/* #3601826_OPPO_BD193sun_3600mAh_averaged_MasterSlave_Aug20th2018*/
	qcom,max-voltage-uv = <4370000>;
	qcom,fastchg-current-ma = <2000>;
	qcom,fg-cc-cv-threshold-mv = <4360>;
	qcom,nom-batt-capacity-mah = <3600>;
	qcom,batt-id-kohm = <105>;
	qcom,battery-beta = <3380>;
	qcom,battery-type = "oppo_sunwoda_3600mah_averaged_masterslave_aug20th2018";
	qcom,checksum = <0x55BA>;
	qcom,gui-version = "PM660GUI - 0.0.0.45";
	qcom,fg-profile-data = [
		 2B 20 15 05
		 B6 0A 29 06
		 FE 1C 09 FB
		 2A 05 49 03
		 FB 17 A3 23
		 A9 44 18 5A
		 89 00 00 00
		 11 00 00 00
		 00 00 C7 BC
		 16 C4 CA B3
		 1B 00 08 00
		 5C DB 17 E4
		 A5 FD A5 00
		 4B FA 00 13
		 B6 E5 C4 2A
		 22 06 09 20
		 27 00 14 00
		 6A 20 DE 04
		 ED 0A E4 05
		 E0 1C 8D 02
		 D7 0C 4B 0B
		 9A 18 94 23
		 55 44 99 5A
		 77 00 00 00
		 0F 00 00 00
		 00 00 2C CD
		 68 C3 30 BD
		 17 00 00 00
		 14 EB 17 E4
		 6B F4 85 EB
		 A9 07 1C 03
		 F6 E5 4E 1A
		 AB 33 CC FF
		 07 10 00 00
		 CD 0D EB 45
		 17 00 40 00
		 96 01 0A FA
		 FF 00 00 00
		 00 00 00 00
		 00 00 00 00
		 00 00 00 00
		 00 00 00 00
		 00 00 00 00
		 00 00 00 00
		 00 00 00 00
		 00 00 00 00
		 00 00 00 00
		 00 00 00 00
		 00 00 00 00
		 00 00 00 00
		 00 00 00 00
		 00 00 00 00
		 00 00 00 00
		 00 00 00 00
		 00 00 00 00
		 00 00 00 00
	];
};
